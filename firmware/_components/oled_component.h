// Minimal self-contained SSD1306 128x64 I2C driver (ESP-IDF v5.x i2c_master API).
// Used to show gesture prompts during data collection. Non-fatal: if the OLED
// isn't present, oled_init() returns false and the CSI pipeline runs unaffected.
#pragma once
#include <string.h>
#include <ctype.h>
#include "driver/i2c_master.h"
#include "esp_log.h"

#define OLED_SDA   21
#define OLED_SCL   22
#define OLED_ADDR  0x3C
#define OLED_W     128
#define OLED_H     64

static i2c_master_bus_handle_t  s_oled_bus = NULL;
static i2c_master_dev_handle_t  s_oled_dev = NULL;
static uint8_t s_fb[OLED_W * OLED_H / 8];
static bool s_oled_ok = false;

// 5x7 font, columns LSB=top, ASCII 0x20..0x5F
static const uint8_t OLED_FONT[64][5] = {
{0x00,0x00,0x00,0x00,0x00},{0x00,0x00,0x5F,0x00,0x00},{0x00,0x07,0x00,0x07,0x00},{0x14,0x7F,0x14,0x7F,0x14},
{0x24,0x2A,0x7F,0x2A,0x12},{0x23,0x13,0x08,0x64,0x62},{0x36,0x49,0x55,0x22,0x50},{0x00,0x05,0x03,0x00,0x00},
{0x00,0x1C,0x22,0x41,0x00},{0x00,0x41,0x22,0x1C,0x00},{0x14,0x08,0x3E,0x08,0x14},{0x08,0x08,0x3E,0x08,0x08},
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{0x02,0x04,0x08,0x10,0x20},{0x00,0x41,0x41,0x7F,0x00},{0x04,0x02,0x01,0x02,0x04},{0x40,0x40,0x40,0x40,0x40},
};

static void oled_cmd(uint8_t c) {
    uint8_t b[2] = {0x00, c};
    i2c_master_transmit(s_oled_dev, b, 2, 50);
}

static void oled_flush(void) {
    if (!s_oled_ok) return;
    oled_cmd(0x21); oled_cmd(0x00); oled_cmd(0x7F);   // column 0..127
    oled_cmd(0x22); oled_cmd(0x00); oled_cmd(0x07);   // page 0..7
    static uint8_t buf[1 + sizeof(s_fb)];
    buf[0] = 0x40;
    memcpy(buf + 1, s_fb, sizeof(s_fb));
    i2c_master_transmit(s_oled_dev, buf, sizeof(buf), 200);
}

static void oled_pixel(int x, int y, int on) {
    if (x < 0 || x >= OLED_W || y < 0 || y >= OLED_H) return;
    uint8_t *p = &s_fb[x + (y / 8) * OLED_W];
    if (on) *p |= (1 << (y & 7)); else *p &= ~(1 << (y & 7));
}

static void oled_char(int x, int y, char ch, int scale) {
    ch = toupper((unsigned char)ch);
    if (ch < 0x20 || ch > 0x5F) ch = ' ';
    const uint8_t *g = OLED_FONT[ch - 0x20];
    for (int col = 0; col < 5; col++)
        for (int row = 0; row < 7; row++)
            if (g[col] & (1 << row))
                for (int dx = 0; dx < scale; dx++)
                    for (int dy = 0; dy < scale; dy++)
                        oled_pixel(x + col * scale + dx, y + row * scale + dy, 1);
}

// draw a horizontally-centered string; y is top pixel row
static void oled_text_center(int y, const char *s, int scale) {
    int cw = 6 * scale;                        // 5px glyph + 1px gap
    int w = (int)strlen(s) * cw;
    int x = (OLED_W - w) / 2; if (x < 0) x = 0;
    for (const char *p = s; *p; p++) { oled_char(x, y, *p, scale); x += cw; }
}

// public: show a big top line + smaller bottom line (auto-shrinks long text)
static void oled_show(const char *big, const char *small) {
    if (!s_oled_ok) return;
    memset(s_fb, 0, sizeof(s_fb));
    int bscale = (strlen(big) <= 10) ? 2 : 1;
    oled_text_center(big && small ? 14 : 26, big ? big : "", bscale);
    if (small && *small) oled_text_center(46, small, 1);
    oled_flush();
}

static bool oled_init(void) {
    i2c_master_bus_config_t bcfg = {
        .i2c_port = -1,
        .sda_io_num = (gpio_num_t)OLED_SDA,
        .scl_io_num = (gpio_num_t)OLED_SCL,
        .clk_source = I2C_CLK_SRC_DEFAULT,
        .glitch_ignore_cnt = 7,
    };
    bcfg.flags.enable_internal_pullup = true;
    if (i2c_new_master_bus(&bcfg, &s_oled_bus) != ESP_OK) return false;
    i2c_device_config_t dcfg = {
        .dev_addr_length = I2C_ADDR_BIT_LEN_7, .device_address = OLED_ADDR,
        .scl_speed_hz = 400000,
    };
    if (i2c_master_bus_add_device(s_oled_bus, &dcfg, &s_oled_dev) != ESP_OK) return false;
    s_oled_ok = true;
    static const uint8_t init_seq[] = {
        0xAE, 0xD5,0x80, 0xA8,0x3F, 0xD3,0x00, 0x40, 0x8D,0x14, 0x20,0x00,
        0xA1, 0xC8, 0xDA,0x12, 0x81,0xCF, 0xD9,0xF1, 0xDB,0x40, 0xA4, 0xA6, 0xAF
    };
    for (size_t i = 0; i < sizeof(init_seq); i++) oled_cmd(init_seq[i]);
    memset(s_fb, 0, sizeof(s_fb));
    oled_flush();
    return true;
}
